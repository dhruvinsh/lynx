## config/boards/shields/lynx/Kconfig.shield
```kconfig
# vim: set ts=4 sw=4:

config SHIELD_LYNX_LEFT
	def_bool $(shields_list_contains,lynx_left)

config SHIELD_LYNX_RIGHT
	def_bool $(shields_list_contains,lynx_right)
```
